/*
████████╗███████╗ ██████╗███╗   ██╗ ██████╗ ██╗      ██████╗  ██████╗ ██╗ █████╗     
╚══██╔══╝██╔════╝██╔════╝████╗  ██║██╔═══██╗██║     ██╔═══██╗██╔════╝ ██║██╔══██╗    
   ██║   █████╗  ██║     ██╔██╗ ██║██║   ██║██║     ██║   ██║██║  ███╗██║███████║    
   ██║   ██╔══╝  ██║     ██║╚██╗██║██║   ██║██║     ██║   ██║██║   ██║██║██╔══██║    
   ██║   ███████╗╚██████╗██║ ╚████║╚██████╔╝███████╗╚██████╔╝╚██████╔╝██║██║  ██║    
   ╚═╝   ╚══════╝ ╚═════╝╚═╝  ╚═══╝ ╚═════╝ ╚══════╝ ╚═════╝  ╚═════╝ ╚═╝╚═╝  ╚═╝    
                                                                                     
██████╗ ███████╗    ██╗██████╗  ██████╗ ███╗   ██╗███╗   ███╗ █████╗ ███╗   ██╗      
██╔══██╗██╔════╝    ██║██╔══██╗██╔═══██╗████╗  ██║████╗ ████║██╔══██╗████╗  ██║      
██║  ██║█████╗      ██║██████╔╝██║   ██║██╔██╗ ██║██╔████╔██║███████║██╔██╗ ██║      
██║  ██║██╔══╝      ██║██╔══██╗██║   ██║██║╚██╗██║██║╚██╔╝██║██╔══██║██║╚██╗██║      
██████╔╝███████╗    ██║██║  ██║╚██████╔╝██║ ╚████║██║ ╚═╝ ██║██║  ██║██║ ╚████║      
╚═════╝ ╚══════╝    ╚═╝╚═╝  ╚═╝ ╚═════╝ ╚═╝  ╚═══╝╚═╝     ╚═╝╚═╝  ╚═╝╚═╝  ╚═══╝    
BY: Juan David Alfonso 
*/                                                                        

////////TECNOLOGIA DE IRONMAN --- CODE//////////

// Inclusion de las bibliotecas necesarias
#include <ESP8266WiFi.h>  ////library esp8266
//#include <WiFi.h>  // Biblioteca para ESP32  (DESCOMENTAR SI SE USA CHIP ESP32)
#include <Wire.h>
#include <Adafruit_GFX.h>        // Biblioteca para la pantalla OLED
#include <Adafruit_SSD1306.h>                                                                                     ///////////////////

#include <Adafruit_NeoPixel.h>
#ifdef __AVR__
#include <avr/power.h> // Required for 16 MHz Adafruit Trinket
#endif

// Which pin on the Arduino is connected to the NeoPixels?
// On a Trinket or Gemma we suggest changing this to 1:
#define LED_PIN    12

// How many NeoPixels are attached to the Arduino?
#define LED_COUNT 23

// Declare our NeoPixel strip object:

#define SCREEN_WIDTH 128 // OLED display width, in pixels
#define SCREEN_HEIGHT 64 // OLED display height, in pixels
#define OLED_RESET     -1 // Reset pin # (or -1 if sharing Arduino reset pin)
#define SCREEN_ADDRESS 0x3C ///< See datasheet for Address

#define LOGO_HEIGHT   60    // OLED LOGO height, in pixels
#define LOGO_WIDTH    120  // OLED LOGO width, in pixels
#define LOGO_HEIGHT2   50            ///
#define LOGO_WIDTH2    120          ///


// Inicializacion de la pantalla OLED
Adafruit_SSD1306 display(SCREEN_WIDTH, SCREEN_HEIGHT, &Wire, OLED_RESET);
Adafruit_NeoPixel strip(LED_COUNT, LED_PIN, NEO_GRB + NEO_KHZ800);



// Hexadecimales de las imagenes mostradas en la pantalla OLED
const unsigned char PROGMEM logoiron [] = {
	0x00, 0x00, 0x00, 0x00, 0x00, 0x00, 0x00, 0x00, 0x00, 0x00, 0x00, 0x00, 0x00, 0x00, 0x00, 0x00, 
	0x00, 0x00, 0x00, 0x00, 0x00, 0x00, 0x00, 0x00, 0x00, 0x00, 0x00, 0x00, 0x00, 0x00, 0x00, 0x00, 
	0x00, 0x00, 0x00, 0x00, 0x00, 0x00, 0x00, 0x00, 0x00, 0x00, 0x00, 0x00, 0x00, 0x00, 0x00, 0x00, 
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	0x00, 0x00, 0x00, 0x00, 0x00, 0x00, 0x00, 0x00, 0x00, 0x00, 0x00, 0x00, 0x00, 0x00
};
const unsigned char PROGMEM iron [] = {
	0x00, 0x00, 0x00, 0x00, 0x00, 0x00, 0x00, 0x00, 0x00, 0x00, 0x00, 0x00, 0x00, 0x00, 0x00, 0x00, 
	0x00, 0x00, 0x00, 0x00, 0x00, 0x00, 0x00, 0x00, 0x00, 0x00, 0x00, 0x00, 0x00, 0x00, 0x00, 0x00, 
	0x00, 0x00, 0x00, 0x00, 0x00, 0x00, 0x00, 0x00, 0x00, 0x00, 0x00, 0x00, 0x00, 0x00, 0x00, 0x00, 
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	0x00, 0x00, 0x00, 0x00
};

const unsigned char PROGMEM SA [] ={
  0x00, 0x00, 0x00, 0x00, 0x00, 0x00, 0x00, 0x00, 0x00, 0x00, 0x00, 0x00, 0x00, 0x00, 0x00, 0x00, 
	0x00, 0x00, 0x00, 0x00, 0x00, 0x00, 0x00, 0x00, 0x00, 0x00, 0x00, 0x00, 0x00, 0x00, 0x00, 0x00, 
	0x7d, 0xff, 0x3f, 0x1f, 0x9f, 0xe1, 0xfc, 0x3e, 0x7b, 0xfd, 0xe7, 0x80, 0x00, 0x00, 0x00, 0xfe, 
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	0x00, 0x00, 0x00, 0x00
};

const unsigned char PROGMEM SD [] ={ 
  0x00, 0x00, 0x00, 0x00, 0x00, 0x00, 0x00, 0x00, 0x00, 0x00, 0x00, 0x00, 0x00, 0x00, 0x00, 0x00, 
	0x00, 0x00, 0x00, 0x00, 0x00, 0x00, 0x00, 0x00, 0x00, 0x00, 0x00, 0x00, 0x00, 0x00, 0x00, 0x00, 
	0x7d, 0xff, 0x3f, 0x1f, 0x9f, 0xe1, 0xfc, 0x3e, 0x7b, 0xfd, 0xe7, 0x80, 0x00, 0x00, 0x00, 0xfe, 
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	0x00, 0x00, 0x00, 0x00
};

const unsigned char PROGMEM PA [] ={
	0x00, 0x00, 0x00, 0x00, 0x00, 0x00, 0x00, 0x00, 0x00, 0x00, 0x00, 0x00, 0x00, 0x00, 0x00, 0x00, 
	0x00, 0x00, 0x00, 0x00, 0x00, 0x00, 0x00, 0x00, 0x00, 0x00, 0x00, 0x00, 0x00, 0x00, 0x00, 0x00, 
	0x00, 0x00, 0x00, 0x00, 0x00, 0x00, 0x00, 0x00, 0x00, 0x00, 0x00, 0x00, 0x00, 0x00, 0x00, 0x00, 
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	0x00, 0x00, 0x00, 0x00
};

const unsigned char PROGMEM PD [] = {
	0x00, 0x00, 0x00, 0x00, 0x00, 0x00, 0x00, 0x00, 0x00, 0x00, 0x00, 0x00, 0x00, 0x00, 0x00, 0x00, 
	0x00, 0x00, 0x00, 0x00, 0x00, 0x00, 0x00, 0x00, 0x00, 0x00, 0x00, 0x00, 0x00, 0x00, 0x00, 0x00, 
	0x00, 0x00, 0x00, 0x00, 0x00, 0x00, 0x00, 0x00, 0x00, 0x00, 0x00, 0x00, 0x00, 0x00, 0x00, 0x00, 
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	0x00, 0x00, 0x00, 0x00
};

const unsigned char PROGMEM AA [] = {
  0x00, 0x00, 0x00, 0x00, 0x00, 0x00, 0x00, 0x00, 0x00, 0x00, 0x00, 0x00, 0x00, 0x00, 0x00, 0x00, 
	0x00, 0x00, 0x00, 0x00, 0x00, 0x00, 0x00, 0x00, 0x00, 0x00, 0x00, 0x00, 0x00, 0x00, 0x00, 0x00, 
	0x00, 0x00, 0x00, 0x00, 0x00, 0x00, 0x00, 0x00, 0x00, 0x00, 0x00, 0x00, 0x00, 0x00, 0x00, 0x00, 
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	0x00, 0x00, 0x00, 0x00
};

const unsigned char PROGMEM AD [] = {
  0x00, 0x00, 0x00, 0x00, 0x00, 0x00, 0x00, 0x00, 0x00, 0x00, 0x00, 0x00, 0x00, 0x00, 0x00, 0x00, 
	0x00, 0x00, 0x00, 0x00, 0x00, 0x00, 0x00, 0x00, 0x00, 0x00, 0x00, 0x00, 0x00, 0x00, 0x00, 0x00, 
	0x00, 0x00, 0x00, 0x00, 0x00, 0x00, 0x00, 0x00, 0x00, 0x00, 0x00, 0x00, 0x00, 0x00, 0x00, 0x00, 
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	0x00, 0x00, 0x00, 0x00
};

const unsigned char PROGMEM MIX [] = {
  0x00, 0x00, 0x00, 0x00, 0x00, 0x00, 0x00, 0x00, 0x00, 0x00, 0x00, 0x00, 0x00, 0x00, 0x00, 0x00, 
	0x00, 0x00, 0x00, 0x00, 0x00, 0x00, 0x00, 0x00, 0x00, 0x00, 0x00, 0x00, 0x00, 0x00, 0x00, 0x00, 
	0x00, 0x00, 0x00, 0x00, 0x00, 0x00, 0x00, 0x00, 0x00, 0x00, 0x00, 0x00, 0x00, 0x00, 0x00, 0x00, 
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	0x00, 0x00, 0x00, 0x00
};

const unsigned char PROGMEM ALL [] = {
  0x00, 0x00, 0x00, 0x00, 0x00, 0x00, 0x00, 0x00, 0x00, 0x00, 0x00, 0x00, 0x00, 0x00, 0x00, 0x00, 
	0x00, 0x00, 0x00, 0x00, 0x00, 0x00, 0x00, 0x00, 0x00, 0x00, 0x00, 0x00, 0x00, 0x00, 0x00, 0x00, 
	0x00, 0x00, 0x00, 0x00, 0x00, 0x00, 0x00, 0x00, 0x00, 0x00, 0x00, 0x00, 0x00, 0x00, 0x00, 0x00, 
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	0x06, 0x0f, 0xe0, 0x00
};



///////// INFORMACIÓN WIFI //////////
const char* ssid = "IRON"; // EDITAR PARA LA RED LOCAL A LA CUAL SE VAYA A CONECTAR EL ESP8266 /// por defecto (ssid: "IRON", password: 12345678j)
const char* password = "12345678j"; ///****************************************///


// Configuracion del servidor WiFi en el puerto 80
WiFiServer server(80);  ///// PUERTO DE CONECCIÓN WIFI

String header;

// Variables para el manejo de tiempo y cabeceras HTTP
unsigned long lastTime, timeout = 2000;

///////////////////////////// PINES LEDS ///////////////////////////
// Definicion de pines para LEDs
const int LED1 = 16; // pin de salida          ///// EDITAR SEGÚN LOS PINES UTILIZADOS EN LA TECNOLOGIA DE IRONMAN SON LOS 5,4,0 y 2 respectivamente. ////////////////////
const int LED2 = 2; // pin de salida
const int LED3 = 14; // pin de salida

int wait = 1000;

// Variables para almacenar el estado de las salidas
String outputState =  "apagado"; //almacenar el estado actual de la salida
String outputState1 = "apagado"; //almacenar el estado actual de la salida 1
String outputState2 = "apagado"; //almacenar el estado actual de la salida 2
String outputState3 = "apagado"; //almacenar el estado actual de la salida 3
String outputState4 = "apagado"; //almacenar el estado actual de la salida 3
String status;   /////VARIABLE QUE DETERMINA EL ESTADO A MOSTRAR EN OLED



/* ------------------------- FUNCIONES DEL CODIGO ---------------------------- */

/* FUNCIONES PARA MOSTRAR ANIMACIONES  */

// Funcion para mostrar una animacion de desplazamiento con el logo
void testscrolliron(void) {
 
 display.clearDisplay();
 display.setTextSize(1);
 display.setTextColor(WHITE);
 display.setCursor(0, 56);
 display.println("By Juan D. Alfonso");
 display.drawBitmap((display.width()-  LOGO_WIDTH2)/2, 0, logoiron, LOGO_WIDTH2, LOGO_HEIGHT2, WHITE);
 display.display();


 // Desplazamiento de la pantalla en varias direcciones con pausas entre ellas:
  display.startscrollright(0x00, 0x0F);
  delay(4000);
  display.stopscroll();
  delay(1000);
  display.startscrollleft(0x00, 0x0F);
  delay(4000);
  display.stopscroll();
  delay(1000);
}
// Funcion para mostrar la direccion IP en la pantalla OLED
void IPSCREEN(){
  display.clearDisplay();
  display.setTextSize(1);
  display.setTextColor(WHITE);
  display.setCursor(0, 10);
  display.println("Dispositivo conectado");
  display.setCursor(22, 30);
  display.println(" Direccion IP: ");
  display.setCursor(20, 50);
  display.println(WiFi.localIP());                                  /////////////IMPRIME LA DIRECCION IP EN PANTALLA 
  display.display();
}

void IRON_F(void) {
 
 display.clearDisplay();
 display.drawBitmap((display.width()-  LOGO_WIDTH)/2, (display.height()-  LOGO_HEIGHT)/2, iron, LOGO_WIDTH, LOGO_HEIGHT, WHITE);
 display.display();

}

void SA_F(void) {
 
 display.clearDisplay();
 display.drawBitmap((display.width()-  LOGO_WIDTH)/2, (display.height()-  LOGO_HEIGHT)/2, SA, LOGO_WIDTH, LOGO_HEIGHT, WHITE);
 display.display();

}

void MS_F(void) {
 
 display.clearDisplay();
 display.drawBitmap((display.width()-  LOGO_WIDTH)/2, (display.height()-  LOGO_HEIGHT)/2, MIX, LOGO_WIDTH, LOGO_HEIGHT, WHITE);
 display.display();
}

void SD_F(void) {
 
 display.clearDisplay();
 display.drawBitmap((display.width()-  LOGO_WIDTH)/2, (display.height()-  LOGO_HEIGHT)/2, SD, LOGO_WIDTH, LOGO_HEIGHT, WHITE);
 display.display();
}

void PA_F(void) {
 
 display.clearDisplay();
 display.drawBitmap((display.width()-  LOGO_WIDTH)/2, (display.height()-  LOGO_HEIGHT)/2, PA, LOGO_WIDTH, LOGO_HEIGHT, WHITE);
 display.display();

}

void PD_F(void) {
 
 display.clearDisplay();
 display.drawBitmap((display.width()-  LOGO_WIDTH)/2, (display.height()-  LOGO_HEIGHT)/2, PD, LOGO_WIDTH, LOGO_HEIGHT, WHITE);
 display.display();
}

void AA_F(void) {
 
 display.clearDisplay();
 display.drawBitmap((display.width()-  LOGO_WIDTH)/2, (display.height()-  LOGO_HEIGHT)/2, AA, LOGO_WIDTH, LOGO_HEIGHT, WHITE);
 display.display();

}

void AD_F(void) {
 
 display.clearDisplay();
 display.drawBitmap((display.width()-  LOGO_WIDTH)/2, (display.height()-  LOGO_HEIGHT)/2, AD, LOGO_WIDTH, LOGO_HEIGHT, WHITE);
 display.display();

}

void ALL_F(void) {
 
 display.clearDisplay();
 display.drawBitmap((display.width()-  LOGO_WIDTH)/2, (display.height()-  LOGO_HEIGHT)/2, ALL, LOGO_WIDTH, LOGO_HEIGHT, WHITE);
 display.display();
}

// Las siguientes funciones controlan diferentes combinaciones de LEDs
void LED1_F(){
 digitalWrite(LED1, LOW);
 digitalWrite(LED2, HIGH);
 digitalWrite(LED3, HIGH);
}

void LED2_F(){
 digitalWrite(LED1, HIGH);
 digitalWrite(LED2,  LOW);
 digitalWrite(LED3, HIGH);
}

void LED3_F(){
 digitalWrite(LED1,HIGH);
 digitalWrite(LED2,HIGH);
 digitalWrite(LED3, LOW);
}
 
 
void MIX_F(){
 LED1_F();
 delay(wait);
 LED2_F();
 delay(wait);
 LED3_F();
 delay(wait);
}

//Funcion que apaga todos los leds 

//Funcion que apaga todos los leds 
void OFF_F(){
  digitalWrite(LED1, HIGH);
  digitalWrite(LED2, HIGH);
  digitalWrite(LED3, HIGH);
}

//Funcion que enciende todos los leds 
void LALL_F(){
 digitalWrite(LED1, LOW);
 digitalWrite(LED2, LOW);
 digitalWrite(LED3, LOW);
}


void colorWipe(uint32_t color, int wait) {
  for(int i=0; i<strip.numPixels(); i++) { // For each pixel in strip...
    strip.setPixelColor(i, color);         //  Set pixel's color (in RAM)
    strip.show();                          //  Update strip to match
    delay(wait);                           //  Pause for a moment
  }
}

void theaterChase(uint32_t color, int wait) {
  for(int a=0; a<10; a++) {  // Repeat 10 times...
    for(int b=0; b<3; b++) { //  'b' counts from 0 to 2...
      strip.clear();         //   Set all pixels in RAM to 0 (off)
      // 'c' counts up from 'b' to end of strip in steps of 3...
      for(int c=b; c<strip.numPixels(); c += 3) {
        strip.setPixelColor(c, color); // Set pixel 'c' to value 'color'
      }
      strip.show(); // Update strip with new contents
      delay(wait);  // Pause for a moment
    }
  }
}


void setup() {
  // Inicializa la comunicacion serial a una velocidad de 115200 baudios.
  Serial.begin(115200);
  // Configura los pines de los LEDs como salidas.
  pinMode(LED1, OUTPUT);
  pinMode(LED2, OUTPUT);
  pinMode(LED3, OUTPUT);
  // Apaga todos los LEDs.
  

  #if defined(__AVR_ATtiny85__) && (F_CPU == 16000000)
  clock_prescale_set(clock_div_1);
  #endif
  // END of Trinket-specific code.

  OFF_F();
  strip.begin();           // INITIALIZE NeoPixel strip object (REQUIRED)
  strip.show();            // Turn OFF all pixels ASAP
  strip.setBrightness(255); // Set BRIGHTNESS to about 1/5 (max = 255)


  // Intenta iniciar la pantalla OLED. Si falla, imprime un mensaje de error y entra en un bucle infinito.
  if(!display.begin(SSD1306_SWITCHCAPVCC, SCREEN_ADDRESS)) {
    Serial.println(F("SSD1306 allocation failed"));                                  // SSD1306_SWITCHCAPVCC = generate display voltage from 3.3V internally
    for(;;); // Don't proceed, loop forever
  } 

  // Muestra una animacion inicial en la pantalla OLED.
  testscrolliron();    
  delay(5000); 
  IRON_F();    
  delay(3000);  

  // Imprime un mensaje en la consola serial indicando que esta intentando conectarse a la red WiFi.
  Serial.print("Conectando a ");
  Serial.println(ssid);

 // Inicia el proceso de conexion a la red WiFi con las credenciales proporcionadas.
  WiFi.begin(ssid,password);

 // Muestra un mensaje en la pantalla OLED indicando que esta intentando conectarse a la red WiFi.
 /* ESTE ESPACIO ES REFERENTE A LA VISUALIZACION EN PANTALLA DE LA CONEXION A LA APK */ 
  display.clearDisplay();
  display.setTextSize(1);
  display.setTextColor(WHITE);
  display.setCursor(22, 10);
  display.println(" Conectando a ");
  display.setTextSize(2);
  display.setCursor(35, 25);
  display.println(ssid);             ///// SE IMPRIME EN OLED NOMBRE DE LA RED 
  display.setTextSize(2);
  display.setCursor(45, 45);
  display.println("APK");
  display.display();

 
  Serial.print("Conectando a ");                                      
  Serial.println(ssid);
  WiFi.begin(ssid,password);   

   // Mientras no este conectado a la red WiFi, sigue intentando y muestra puntos en la consola serial.
  while(WiFi.status() != WL_CONNECTED)
  {
    delay(500);
    Serial.print(".");
  }
  // Una vez conectado, muestra la direccion IP en la pantalla OLED.
  IPSCREEN();

 // Imprime un mensaje en la consola serial indicando que el dispositivo esta conectado y muestra la direccion IP.
  Serial.println("");
  Serial.println("Dispositivo conectado.");
  Serial.println("Direccion IP: ");
  Serial.print(WiFi.localIP());
  // Inicia el servidor en el puerto 80.
  server.begin();

}

void loop() {
 // Espera a que un cliente se conecte al servidor
  WiFiClient client = server.available();
// Si hay un cliente conectado
  if(client)
  {
     // Guarda el tiempo actual para controlar el tiempo de espera
    lastTime = millis();
     
    // Imprime un mensaje indicando que hay un nuevo cliente
    Serial.println("Nuevo cliente");

    // Inicializa una cadena para guardar la linea actual que se esta leyendo
    String currentLine = "";

 // Mientras el cliente este conectado y no se haya superado el tiempo de espera
    while(client.connected() && millis() - lastTime <= timeout)
    {

 // Si hay datos disponibles para leer del cliente
      if(client.available())
      { 
        // Lee un caracter del cliente  
        char c = client.read();
        Serial.write(c);
        header += c;
        
         // Si el caracter leido es un salto de linea
        if(c == '\n')
        {
          // Si la linea actual esta vacia, significa que hemos llegado al final del encabezado HTTP
          if(currentLine.length() == 0)
          {

            ////////// ENCABEZADO HTTP ////////////
             // Envia una respuesta HTTP al cliente
            client.println("HTTP/1.1 200 OK");
            client.println("Content-type:text/html");
            client.println("Connection: close");
            client.println();


             // Comprueba si el encabezado contiene ciertas cadenas y realiza acciones a partir de estas.

             ////COMANDOS LED 1 //////
            if (header.indexOf("GET /x") >= 0) {
              Serial.println("GPI5 encendido");
              outputState = "encendido";
              status = "B";
              PA_F();

            }   

             else if (header.indexOf("GET /offx") >= 0) {
              Serial.println("GPIO apagado");
              outputState = "apagado";
              status = "BF"; 
              PD_F();            
             }
             /////COMANDOS LED 2 ////////         
            else if (header.indexOf("GET /y") >= 0) {
              Serial.println("GPI4 encendido");
              outputState1 = "encendido";
              status = "R";
              AA_F();

            } 

              else if (header.indexOf("GET /offy") >= 0) {
              Serial.println("GPIO apagado");
              outputState1 = "apagado";
              status = "RF";
              AD_F();
             }

             ///// COMANDOS LED 3 ///////
             else if (header.indexOf("GET /z") >= 0) {
              Serial.println("GPIO encendido");
              outputState2 = "encendido";
              status = "G";
              SA_F();
            } 


              else if (header.indexOf("GET /offz") >= 0) {
              Serial.println("GPIO apagado");
              outputState2 = "apagado";
              status = "GF";
              SD_F();
             }

             //////APAGAR TODOS////
             // Comandos para apagar todos los LEDs
            else if (header.indexOf("GET /off") >= 0) {
              Serial.println("GPIO apagado");
              outputState3 = "apagado";  
              outputState4 = "apagado";      
              status = "OFF";
              IPSCREEN(); 
            } 


            ////// ENCENDER TODOS //////
            // Comandos para encender todos los LEDs
              else if (header.indexOf("GET /on") >= 0) {
              Serial.println("GPIO encendido");
              outputState3 = "encendido";
              status = "ON";
              ALL_F();

            }
            // Comandos para mezclar colores
            else if (header.indexOf("GET /m") >= 0) {
              Serial.println("GPIO encendido");
              outputState4 = "encendido";      
              status = "M";
              MS_F();
            }
            
            
             //////// PAGINA WEB //////////////
             
            client.println("<!DOCTYPE html><html>");
            client.println("<head><meta name=\"viewport\" content=\"width=device-width, initial-scale=1\">");
            client.println("<link rel=\"icon\" href=\"data:,\">");
            client.println("</head>");
            client.println("<body></body>");
            client.println("</html>");
            client.println();
            break;
   
            /////////////////////////////////////
          }
          else
          {
              // Si la linea actual no esta vacia, la reinicia para la siguiente linea
            currentLine = "";
          }
        }
        // Si el caracter leido no es un retorno de carro, lo agrega  a la linea actual
        else if ( c != '\r')
        {
          currentLine += c;
        }
        
        
      }

      
    }
    
// Reinicia el encabezado y cierra la conexion con el cliente
    header = "";
    client.stop();
    Serial.println("Cliente desconectado.");
    Serial.println("");
  }

 // Aqui se revisa el estado actual y se toman acciones en funcion de ese estado
  

  if (status == "B") {  
    digitalWrite(LED1, LOW);
    colorWipe(strip.Color(0, 0, 255), 50);
  }

  else if (status == "BF"){
    digitalWrite(LED1, HIGH);
    colorWipe(strip.Color(0, 0, 0), 50); // Color negro con una velocidad de 50ms
  }

  else if (status == "R") {
     digitalWrite(LED2, LOW);
     colorWipe(strip.Color(255, 0, 0), 50);
     
  }
  
  else if (status == "RF") {
     digitalWrite(LED2, HIGH);
     colorWipe(strip.Color(0, 0, 0), 50); // Color negro con una velocidad de 50ms
  }

  else if (status == "G") {
     digitalWrite(LED3, LOW);
     colorWipe(strip.Color(0, 255, 0), 50);
  }

   else if (status == "GF") {
     digitalWrite(LED3, HIGH);
     colorWipe(strip.Color(0, 0, 0), 50); // Color negro con una velocidad de 50ms
  }

  else if (status == "M") {
    MIX_F();
    theaterChase(strip.Color(127, 127, 127), 50); // White, half brightness
  }

  else if (status == "ON") {
    LALL_F();
    colorWipe(strip.Color(255, 255, 255), 50);
  }
  
  else if (status == "OFF") {
    OFF_F();
   colorWipe(strip.Color(0, 0, 0), 50); // Color negro con una velocidad de 50ms
}
  }

